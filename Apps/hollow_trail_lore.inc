/* Both authors describe the same physical events. Neither is the narrator of truth. */
static const char *const ht_evidence_prose[HT_LEVELS*3] = {
    "A hooked branch carried a torn strip of cloth. I had almost passed it before I saw the hem.\n\nShe stitched badly when she was tired. One neat run, then a little backward bite with the needle, as though she had changed her mind about which way the fabric ought to go. This strip had two of them. I held it against my cheek before I thought to smell it. Wet wool, bark, the mineral cold of the morning. None of the warm things I had expected.\n\nThe cloth had been pushed into a cut in the tree.\n\nA filament held the cloth to the bark. I loosened it separately, then smoothed the wool over my hand as if she might ask what I had done to it. Beneath it lay an older cut, rounded and grown over, where a wedge of bark had been removed facing the road.\n\nInside the folded hem was a paper narrow enough to roll between two fingers.\n\nI have left the route where you can reach it. Do not mistake a path I used for a path I chose.\n\nBelow that she had drawn a small socket with its mouth turned toward the road. Her pen had dug through the paper at the corner.\n\nSomeone had cut a date into the bark. It was earlier than the morning she left our house. Below the date, in smaller letters, were the words:\n\nShe knew which tree.\n\nI read them with my thumb resting on her uneven stitches.\n\nLeaves began falling while I stood there. The branches above me were almost still, but farther into the wood a gust had found the canopy. The leaves came turning out of the gray, dark on one side and silver on the other, and caught in the roots at my feet. For a moment the whole forest seemed occupied by small things changing their minds.\n\nI put the paper in the notebook. I left the cloth where it was.",
    "I entered by a broken shutter and found the register on a sloping desk.\n\nThe desk was hollowed where a hand had rested. Above it, a broken window cast its grid across the floor. In the beam reaching the register, thick strokes of ink shone; the rest of the writing sank into the page.\n\nI drew the desk toward the light. One leg left a bright scrape through the dust. It was the first new mark in the room.\n\nSeven names occupied a ruled column. Six had been written beneath my sister's. Beside each was a square. Some squares were filled; others had been scratched at until the paper had thinned. The heading had been scraped away altogether.\n\nOne hand was small, upright and careful. The other was hers.\n\nRecord every admission before opening the crossing, the careful hand said. She supplied the names without asking the people to speak.\n\nMy sister had crossed out admission so hard that I could feel the damage on the back of the sheet.\n\nThey were too cold to answer you. You knew that. I wrote for them.\n\nI could see her at that desk. Not a vision; a memory finding furniture to inhabit. She bent over work with one shoulder higher than the other, her hair falling forward until she became irritated and pushed it behind her ear with the back of her wrist. When she was angry, she held the pen low enough to stain her fingers.\n\nI had made her angry on the day she left.\n\n\"You always find someone who needs you more,\" I had said.\n\nShe stood in our doorway with her scarf half wound, one end hanging below her coat. There were things I could have done: finish winding it for her, lift the bag she was trying to shoulder, ask who waited beyond the road. Instead I watched her make room in the bag for a second loaf.\n\n\"Come, then,\" she said.\n\nI thought she meant it to punish me.\n\nIn the mill, the paper trembled against my thumb.\n\nI steadied the page with my other hand, covering the six names beneath hers. Then I moved it away.\n\nUnder the argument, the careful writer had added a final line.\n\nI kept the last square open.\n\nHe signed himself the keeper.\n\nThere was no name.",
    "A small cam is hidden inside the wooden bell. Its third socket opens back toward the forest. None of the three handles turns only its own cam. A paper loop carries two explanations of the lantern scratched on its back.\n\nHer hand: \"Three short flashes: follow. Two short and one long: someone is watching. You remember. I taught them so we could speak without words.\"\n\nKeeper's hand: \"She gave me both patterns before I asked. She said a warning is useful only if someone else knows it.\"\n\nI remember learning those signals alone with her. The toy makes that memory less private. Perhaps she needed an ally. Perhaps someone made her surrender the one language she could use to ask me for help. The nail tied to the toy rings each wooden bell with the same small sound.",
    "Her hand on a classroom map: \"The round feed goes to the lower contact; the square feed returns above it. I have put the ladder where you will need it. When the stair door shuts, do not wait beneath it.\"\n\nThe date precedes the recorded closure. The keeper has circled both: \"Who told her which door would lock? I had not yet received the order.\"\n\nShe has answered beneath his circle: \"There was no other way.\"\n\nThe ladder is where the map places it. The door is locked. Those facts support both accounts. She may have foreseen a danger, been warned by whoever ordered it, or chosen the closure herself. The charcoal route touches every roof where a signal can be seen. It also passes none of the doors through which someone could leave unseen.",
    "Keeper's hand on the fuse label: \"The first bank has a scorched upper crossover. Its straight and lower paths still conduct. I disconnected the beacon after the first report. No further travellers should be called until we know where they go.\"\n\nHer hand: \"You disconnected the only light they could see. They disappeared from your windows because they went below them. That is not the same as vanishing.\"\n\nA fresh wire is taped beside the burnt one. Her repair worked; I can test that. His warning about the scorched crossover is also correct. Neither useful instruction proves its author's account of the people below. The report itself is missing. If it came before the disconnection, his act was a response. If the date was copied wrongly, it could have caused the danger he describes.",
    "Beside the chair lay a watch log.\n\nHer signature appeared seven times on two facing pages. I knew the downward stroke that broke near the bottom; I knew the small, impatient blot where she stopped to think. I had seen it on lists left beside our stove, on a note asking me to bring in the washing, on a letter she started and never sent.\n\nHere the blot appeared twice in precisely the same place.\n\nI laid the pages against the window. Outside, gray towers stood in the rain. Their lit windows shone through the paper, and for a moment the writing appeared to belong to the city itself.\n\nAgainst the window, the blots fitted exactly. I moved one sheet aside and returned it; the same hook found the same gap. My breath dampened the paper. I kept holding it carefully, though I wanted it to come apart.\n\nThe keeper had left a sentence along the bottom.\n\nAsk who attended, not whose name appears.\n\nI did not want to give him that sentence. I wanted him to be the man who locked a door and put a generous act into a narrow column. I wanted his care with dates to be a kind of cowardice. It was inconvenient that he had noticed something I would have preferred to miss.\n\nMy sister had written elsewhere in the log:\n\nNobody should keep the whole watch alone.\n\nI sat in the empty chair.\n\nAt home, during the winter our mother was ill, my sister would wake me for my turn at the bed. She always said the same thing: \"You've only to sit there.\" But she stayed in the doorway after I sat, waiting until I had picked up the cup or straightened the blanket. Sometimes I pretended to sleep through her knocking. I could recognise the moment she decided not to knock again. The silence after that decision was different from the silence before it.\n\nThe lamp flashed beside my head.\n\nI stayed until my coat stopped dripping.\n\nAt each flash my open hands cast long shadows between my feet. Outside, the empty chair had frightened me. Sitting in it, I made the same pool of light look occupied.\n\nThe watch log showed how the central return fed the heaters below. The outer lines led toward the lamps.",
    "Her hand around the lantern handle: \"Divide the full supply equally between the two watches. Leave none in the measure. I have put my allowance with the children's. Let them think there is enough.\"\n\nKeeper's hand on the ration ledger: \"The allotment was not hers to give. She was told what would happen if the lamps went out. She agreed before I finished reading the conditions.\"\n\nHer allowance is crossed out and three smaller allowances are increased. A gift and a confiscation would leave the same arithmetic. There is no signature beneath the conditions, only a pressure mark from another sheet. I can make out the word continue. Did she consent because she understood, because she was deceived, or because the others would pay if she refused?",
    "There was a stove in the next shed.\n\nI entered expecting warmth, though no smoke came from the pipe. The room was narrow. Coats had hung along one wall; their outlines remained in the soot. Beneath them stood a bench worn smooth at the edge. A small pile of wood had been sorted by thickness under the stove, the thinnest pieces laid crosswise on top.\n\nThis order hurt me more than the crossed-out ration.\n\nSomeone had thought about the next cold person.\n\nOne shaved stick still held its curl of wood. The bench had been dragged toward the stove at one end, leaving two fresh marks beyond the older pair.\n\nI took the seat at that end. There was no warmth left, but I put my palms toward the iron before lowering them to my knees.\n\nI knelt to inspect the ash. It had formed a hard gray crust, but underneath, a black piece of wood retained the shape of something that had not quite finished burning. A potato skin lay beside the stove leg, curled into a small brown ear.\n\nBehind a loose metal plate I found my sister's note.\n\n*Open the flue. The knocking frightened them, so I tied the loose pipe. Let them sleep.*\n\nThe binding was still there: wire wrapped in cloth, pulled hard around a section of pipe where it met the wall. I touched it. The cloth had become stiff with soot.\n\nTwo knocks sounded beneath the floor.\n\nI did not move.\n\nA third followed, longer, a shudder running through the metal under my fingers.\n\nSoot fell across my cuff. In a dish on the stove, two rings spread through rainwater; the third tremor shook the whole surface. When it stilled, the doorway's reflection returned.\n\nI put my ear to the pipe.\n\nThe sound inside it was enormous and indistinct. Water somewhere, or wind passing a distant opening. My own breath grew loud enough to hide what I was listening for. I held it until my chest hurt.\n\nNothing.\n\n\"I'm here,\" I said.\n\nThe words went into the stove and came back muffled.\n\nI struck the pipe three times with the handle of my knife. The first blow was too light, and I did it again, more carefully.\n\nFor several minutes I waited for an answer.\n\nThen I noticed that I was listening with my face turned toward the floor, exactly where she might have knelt. I moved away as if I had put my hand on something hot.\n\nThe keeper had written on the back of her note.\n\n*The binding held. The knocks continued. She said the metal was cooling. Then she asked me to leave the room.*\n\nOutside, grit scraped against the door.\n\nI wanted to dislike him for staying long enough to hear what she had asked him not to hear. I wanted to ask why he had not opened the floor. I went around the room myself, pulling at boards with my fingers, but they were bolted to iron joists. A hatch under the bench had a recessed catch and no ring to lift it by.\n\nI tried the knife until the tip bent.\n\nWhen I stood, the light had changed. The dust outside was thinning. Through a crack in the wall I could see the side of a tank, pale now beneath the clearing sky, with one dark streak running down it from a seam.\n\nThe pipe did not knock again.\n\nI left the stove door open.\n\nAt the distribution taps, a transfer stops only when a vessel is full or the other is empty.",
    "Farther west, the ground dropped toward a distribution station. Empty cans stood under an awning. Their handles had been tied together so they would not blow away, and when I touched one the whole row moved with a soft clattering complaint.\n\nThe last can contained two lists rolled inside each other.\n\nMy sister had written on the outer one:\n\n*Seven travelling now. Leave an eighth line. I cannot promise they will come, but I can leave room.*\n\nOn the inner list, the eighth line was already filled with the first letter of my name.\n\nThe date was earlier than her arrival at the station.\n\nI sat on the low wall with the can between my feet.\n\nI spread the lists across my knees: the empty line on the left, my initial on the right. I brought the sheets together, then parted them.\n\nA gust lifted the blank list. I caught that one first. Beyond the tanks, the first rail embankment cut across the plain. It was close enough to seem reachable before dark. I stayed sitting.\n\nWhen she left, she had said *come*. That was all. A word thrown back from the doorway while I was still trying to make her feel the weight of going.\n\nI had treasured the belief that following her now was an act she had not asked of me. I could surprise her. I could arrive carrying food, or lift something she could no longer lift, or stand between her and whoever had made her write that first note. It had been a childish picture, but it was mine.\n\nI took out the notebook and wrote down both dates. My hand was clumsy with cold. The first letter of my name, copied beside her list, looked strange to me. I crossed it out, then rubbed at the crossing until the paper began to pill.\n\nThree vessels fed the station through connecting taps. She had marked them eight, five and three: eight measures to be divided equally between two watches, leaving the smallest vessel empty. I poured in the last light, each transfer stopping when a vessel filled or emptied. Twice I arrived back where I had begun. At last four measures stood in each of the larger vessels.\n\nI released the feed. The service lamps steadied along the line of tanks.\n\nNear my hand, the empty measure reflected the sky. A narrow, dark face looked up from its bottom, lengthened by the metal until I hardly recognised it.\n\nI went toward the railway before the lamps became bright enough to guide me.",
    "Inside the station, a ticket marked HOME had been pinned to a noticeboard.\n\nThe word was printed in the same ordinary type as the destination codes around it. Someone had punched the ticket. Its small missing circle gave me a view of the wood behind.\n\nA fold crossed HOME. I smoothed it with my palm; it returned as soon as I let go.\n\n*They told us the next train would not stop,* my sister had written. *We were not permitted to wait.*\n\nThe cancellation book lay open beneath it. The keeper's account put the cancellation before the collapse.\n\n*She asked me to cancel it before the snow. She said the passengers would stay if they believed a train was coming.*\n\nAbove the book hung a weather warning, its paper dry and stiff. The date was earlier still.\n\nI stepped outside to look at the cutting.\n\nA white scrape showed where the hillside had let go. Trees lay in the earth at odd angles, their roots turned outward. The rails entered the fall and did not come out. A length of telegraph wire descended into it like a line dropped through ice.\n\nThe cancellation had saved someone from waiting for a train that would never arrive.\n\nI went back inside and read the ticket again.\n\nThe benches faced the tracks. There was room on them for all seven travellers, with a little space left at the end. I imagined them sitting there while she tried to persuade them to leave. The oldest man would have kept his hat on. One child would have asked the same question until an adult answered sharply. Someone would have offered to go and look, and she would have said there was no need, or there was no time, or she had already looked.\n\nI could hear her making her voice patient.\n\nI had disliked that voice when it was used on me. It made refusal feel like breaking something carefully held.\n\nThe ticket went into my notebook. I left the weather warning where it was.\n\nThe shunting instruction remains: the people travel between the heavy brake and the fuel.",
    "The main road departs left, down the marsh grade. The heavy brake must be at the downhill end. The loop holds two wagons; the short spur holds only one. The coupler can take only the last wagon on a road. Both accounts agree on that practical fact.\n\nHer hand: \"He showed us a way across. I could not have brought them through without him.\"\n\nKeeper's hand: \"She corrected my map. The old service spur is gone, exactly as she said. She told the others I had found the route. Why give me credit for knowledge I did not have?\"\n\nThe corrected line matches the track in front of me. Perhaps someone had supplied her a newer survey. Perhaps she gave him credit to make the group trust him. Perhaps she needed him to believe he was helping while she led him somewhere of her choosing. His next question is pressed into the paper but erased: \"Who has been here before?\"",
    "The letter says THANK YOU LAMP KEEPER in large uneven capitals. Beneath it, her familiar hand supplies the route: \"Keep the people between the brake and the fuel. The departure record counts every wagon back on the main road. Tunnel fallen. Leave this here for the next watch.\"\n\nThe keeper has added on the envelope: \"She told the child what to write. The child asked whether the lamp keeper was the one who had shut the door. She said there could be more than one.\"\n\nDictated thanks need not be false. A child may need help addressing a letter. But the name belongs to a role, not a person, and I have been treating every occurrence as a witness to the same man's kindness or cruelty. The two adults use it without explaining whom they mean. The child at least thought to ask.",
    "Her hand tied to the token: \"The ferry waits in the lower chamber. The marsh is at the zero mark and the quarry channel is at the fourth. Water pressure holds an unequal gate shut. I gave him what we had. He said it was enough for all of us.\"\n\nKeeper's hand in the ferry book: \"No fare was taken. She presented a transfer permit. The boatman recognised the seal and opened the holding gate.\"\n\nThe seal is a boat inside three grooves. The same grooves appear on the gate lock. A permit could be authority she obtained to help the group, an order directing where they must go, or an instrument she had arranged before the journey began. The metal is old, its string new. Whoever issued it expected it to be passed from hand to hand, and did not think the people holding it needed to know its history.",
    "An awning had been fastened between two posts. Under it stood a long bench and a chair with one leg sunk into the ground. Beside the chair, a groove had been worn into the planks of a small platform. It was narrow, round at the end, and repeated so many times that the wood had gone smooth.\n\nA walking stick had rested there.\n\nI sat on the bench and tried putting the imagined stick down in the groove.\n\nSackcloth cushioned the chair. I rested my elbow on its arm: the right height for a tired person to hold their head. Three sets of shoe scuffs marked the bench beside it, the smallest stopping halfway down. From the chair, the old man could have watched the channel without turning. Perhaps that was why she had put him there.\n\nMy sister's instruction was tucked into a seam in the awning.\n\n*Wait until everyone can stand.*\n\nI folded it and unfolded it.\n\nThe keeper recorded two days spent here under an instruction he could not countermand. He had underlined *two*.\n\n*She said the delay was hers. I saw the rope tied on their side of the water.*\n\nThe rope still lay there, its thick knot resting against the post.\n\nThe knot had worn an oval in the post. Its cut end was whipped with dozens of patient turns of thread. I loosened it. No lock, no wire, no hidden fastening. I tied it again.\n\nAbove the water, five marks were cut into the bank's board. The bell rope hung beside them. Someone had tied an extra loop low enough for a child to reach.\n\nI pulled it once.\n\nThe bell sounded from the far end of the channel. Its note spread over the marsh and diminished without an echo.\n\nThe bell's pale rim appeared on one side, then the other. Its arc narrowed until it hung wholly dark. I kept hold of the rope.\n\nI waited.\n\nA small creature moved beneath the sedge, making three stems quiver. Far out, a bird lifted and flew just above its reflection. Nothing else answered.\n\nI had intended to leave at once. Instead I remained on the bench until the damp came through my trousers.\n\nLock operating note: There are only four measures of water between both chambers. The weighted float first routes the pump toward the ferry. At the end stop its rocker reverses, so an overshot level can be brought back. Any open gate releases its pressure.",
    "The two middle watermarks coincide. The connecting gate must have the same level on either side before the ferry can drift through. A second chamber is drawn on the reverse of the page, not a second water supply. Beneath it are two lists of the same seven names, one for each bank.\n\nHer hand: \"Released at dawn. All accounted for. I waited until he could stand.\"\n\nKeeper's hand: \"Received at dawn. All accounted for. She made me copy her count before I could speak to any of them.\"\n\nThe two phrases occupy corresponding boxes on forms with their headings washed away. Release and receipt might describe an ordinary evacuation. They might describe the transfer of prisoners. Her concern for the old man's strength can be real in either case. I lay the sheets together against the light. Their missing headings are exactly the information that would let either account become more than a persuasive description.",
    "On the other side, a child's pouch lay beneath a slab.\n\nIt contained six stones chosen for their likeness in size. Their surfaces had been rubbed clean, and one bore a charcoal face. Held one way, the face smiled. Turned over, it seemed to frown.\n\nThe drawn mouth followed a chip in the stone. One edge was smooth from being turned in a pocket. I turned it now, wondering which expression had come first.\n\nMy sister's note was folded into the bottom.\n\n*We played at moving a family across the quarry while the real lift was repaired. Keep these little stones out of the gears.*\n\nI set them on the slab. They made a small, uneven line. Without intending to, I placed the smiling stone at the front.\n\nThe keeper's repair report lay under the pouch.\n\n*They knew which stones to move when she rang the bell. She called it a game. I could not get them to try another order.*\n\nI left the stones in their line while I read. A fly settled on the largest. It rubbed its forelegs together and departed.\n\nMy sister used to make games out of anything that needed doing. During a leak in our roof, we carried bowls from room to room according to a complicated ranking of ships. A chipped basin was the admiral. The little blue cup had to be rescued every time it filled. I remembered it as a happy afternoon until, years later, she told me she had spent it terrified that the plaster above the bed would come down.\n\n\"Why didn't you tell me?\" I asked.\n\n\"What would you have done?\"\n\nI had no answer that satisfied either of us.\n\nI gathered the six stones and put them back in the pouch. The one with the face went in last. Its expression changed as it turned between my fingers.\n\nHoist guidance: Six equal loads belong to the hoist, shared between its arms and brake. Keep these little stones out of the gears.",
    "Her scarf binds the repaired brake handle. Her note says: \"The brake takes the loads left over after the arms balance. Both arms and the brake must bear weight. The six stones pass along a closed return; none can be added or discarded. I could not let them fall.\"\n\nThe keeper has written a load calculation beside it: \"She knew the setting before we weighed the cage. She called the margin unsafe, then changed it herself. I did not see a table in her hands.\"\n\nThe binding makes the handle safe to grip. That kindness is visible, whatever brought her here. The calculation is accurate too. She may have been trained, quietly instructed, or better at this machinery than anyone was willing to admit. Beneath the paper I find a rectangular clean patch, the right shape for a plate someone removed. The knowledge could have come from there. It could have been taken away to make hers seem impossible.",
    "Her hand: \"The left arm reaches three paces from its pivot; the right reaches two. A longer arm needs less weight. Three children, two adults, one old man. Six are still with me. Leave it ready for whoever follows.\"\n\nThe keeper has corrected the count: \"Seven, including you.\"\n\nOnce I would have read that as kindness toward someone who forgot to count herself. Now I notice that his seven matches the ferry's admission list. He may be reminding her she matters. He may be reminding her that she is subject to the same restriction as the others.\n\nOn the torn edge her next sentence begins, \"When I am no longer with them...\" The rest is gone. It could be a plan to leave, a fear of being taken away, or an instruction for what the group must do without its leader. I cannot restore the missing words by wanting one version.",
    "In the next house, seven sleeping places had been made between the beds. Straw pallets lay on wooden frames raised just clear of the warm soil. Someone had cut a curtain from old sacking and strung it between two posts. Behind it were a basin, a towel dried stiff, and a little shelf carrying a comb with three teeth missing.\n\nUneven stitches joined the sacking; a stone weighted one crooked corner. Behind it a person would be visible only by their feet. I pressed a clean fold of the towel to my cheek and left a print of quarry dust.\n\nI lingered in that improvised privacy.\n\nThere were curtains at home we had never hung properly. One corner sagged because the hook had come away from the plaster. My sister used to catch it back with a pin whenever she passed. I had resented being reminded of the repair by her small, repeated act. Here she had found a wall where there was no wall, a room inside a ruined building, and I wanted to lie down behind the sacking and let her arrange the rest of the world.\n\nI chose the pallet farthest from the door.\n\nThen I saw the lock.\n\nIt was on the inside. A heavy iron box bolted to the frame, its catch reachable without going out into the cold. The key was gone. A wedge kept the door open now, but the floor beneath it bore a wide scrape from repeated closing.\n\nOne pallet lay just beyond the door's worn arc. I lifted the wedge. As the door moved, the bright strip on the floor narrowed and the nearest leaves lost their shine. I caught it and pushed the wedge back.\n\nThe keeper's inventory lay on the workbench.\n\n*They had food, heat and beds. She kept the key and told them the cold would kill anyone who left.*\n\nHe had written the temperatures beneath the accusation. Low figures, each followed by a neat degree mark. Several were so low that I read them twice.\n\nMy hand went back to the warm pipe.\n\nGlasshouse guidance: The low receiver is sealed behind condensation. The dead stem points toward the inlet. The vent above it has a catch that stays open. Keep enough seed dry to begin again.",
    "Her hand: \"A silver face reflects the beam around a corner. The black face stops it; an empty frame lets it pass. Turn the trays when they lean. Write tomorrow's count even if I am gone. Someone must know what is still growing.\"\n\nKeeper's hand: \"Tomorrow's count was entered before dawn. It repeats yesterday's crossed-out digit, including the correction. Ask who held the pen.\"\n\nThe label contains two identical corrections. Someone could have copied yesterday's form to save time. Someone could have used a mechanical copying arm like the one described on an old maintenance tag. The plants are real and have been tended; that does not prove the person whose writing records them was present. I have been using handwriting as a witness. Here it begins to behave like another object that can be moved.",
    "The lantern is larger than the woman carrying it. Her hand adds: \"The drawing labels the high receiver with a vent and the low one with a latch. The high path must stay straight through the last frame; the low path turns toward the floor. They promised they would keep it lit. I did not ask them to promise.\"\n\nThe keeper has placed an older training card beside the drawing. Its figures stand in the same order. \"The picture came before the promise,\" he writes. \"She gave them this to copy.\"\n\nChildren copy things they love as readily as things they are told to learn. The card could have helped them draw a real event. Yet the woman on it has the same shortened scarf as my sister, although its print date is older than the cuts I found in the forest. A familiar uniform? A coincidence? A picture she chose to resemble? I copy the date without choosing for the child.",
    "Her hand: \"The triangle on the turbine gauge marks three measures for a cold start. The round running mark is one scratch lower. I restored power for the signal. It held through the night. You cannot ask people to wait in darkness.\"\n\nKeeper's hand on the circuit diagram: \"The recorder shares the feed. She knew that. Restoring the lamp also restored the writing arm in the tower.\"\n\nThe drawing shows one wire dividing into two. This is the first physical connection between the lights and the repeated handwriting. It proves that the systems can work together, not why she powered them. She may have accepted a dangerous side effect to call for help. She may have been told the second wire was harmless. Or the writing arm may have been the part she intended to wake. I can follow the copper. I cannot follow her intention along it.",
    "At the distributor, the cold return had lost its prime. The garden line needed filling before its smaller running share would hold. I closed the ridge bypass and gave the turbine and return the cold-start load. The wheel resisted, then loosened. Deep inside the wall, water struck an empty space and filled it.\n\nI waited with my palm on the pipe.\n\nIt warmed by degrees.\n\nCondensation cleared beneath my palm and dwindled along the pipe toward the gardens. I pictured warm air stirring the leaves beside my pallet. When the pressure steadied, I reduced the return and opened the ridge supply. The gauge settled over the running marks. A relay began clicking behind the wall.\n\nFor a few seconds I could hear it beneath the water.\n\nThen I could not.\n\nI left the distributor with the gardens warm and the ridge powered. I knew what the second feed might wake. I had turned it anyway.\n\nEarlier return-pipe record:\n\nHer hand: \"The cold return swallows three measures before it holds pressure. Once full, one measure keeps the gardens warm; the rest can circulate. Do not trade their heat for my call. If someone demands more for the ridge, show them this.\"\n\nKeeper's hand: \"She controlled the common supply. The people below could refuse her instructions only by refusing the heat that kept them alive.\"\n\nThe pipe really returns toward the gardens. Her limit really preserves a share for them. Those facts do not settle whether she was protecting people from an authority above her or making herself the authority they depended on. His account leaves out the night he requested the extra power himself; his signature remains on the request. I do not know whether that omission hides a mistake, a threat, or a part of the arrangement he cannot bear to name.",
    "Her hand: \"The ridge requires half the six-unit supply, but its bypass must remain dry while the return is being primed. Every transfer goes to the next branch; the return closes the loop. Leave my words for the next watch. I cannot be in every place that needs an answer.\"\n\nKeeper's hand in the recorder manual: \"A master plate can move the pen after its author has gone. The sealed original supplies the strokes; the live feed selects the lines. A signature proves a pattern, not a person.\"\n\nA diagram shows two interlocked releases. Removing power opens the master compartment and locks the live selector. Completing the feed exposes the writing arm and shutters the master. Neither action can show both surfaces. Her note may describe ordinary instructions copied for successive watches. His warning may describe impersonation. The same machine could do either. Its lock makes the difference harder, not easier, to inspect.",
    "Her hand in the remaining scarf: \"Start reading the shelter posts at the scarf. Their notches record heights, not directions. I did not know which signs would survive. I left more than one way to find me.\"\n\nKeeper's hand on a tracing: \"Her stitch marks appear on the tower plan. The plan is dated before the first lock was fitted. I thought I was following an order from elsewhere.\"\n\nThe tracing could have been made later and given an earlier date. The keeper may be looking for a way to blame her for work he performed. Yet the little backward stitch appears at a point where no traveller would need a marker, beside the master compartment. Her private habit has become part of a technical drawing. I need the original, not another person's account of it.",
    "Her hand under the stone: \"Four shelter posts trace the ascent. Match each post height to a chime, reading from the cloth toward the ridge. There was no other way.\"\n\nThe keeper's note is the least orderly of his records: \"I believed she was repeating what she had been told. Then she corrected the order before I opened the envelope. I no longer know who gave it.\"\n\nNeither page explains the correction. Someone could have warned her. Someone could have rehearsed it with her. She could have written the order herself. I think of the same phrase in the city, where it sounded like an apology. Here it could be a confession, a defence, or the statement of someone who could see a necessity the rest of us could not. The stone shelters all three readings equally.",
    "Then I followed the wire to its isolator.\n\nThe housing was stiff with ice. I warmed the catch in my hands until it moved. Inside, the inward line passed through a little hinged contact. I lifted it clear with the dry handle of the knife.\n\nThe next set of flashes did not come.\n\nThe ridge stayed gray. An afterimage brightened when I blinked, then faded. Beside me, the open contact showed a silver underside, a fraction of an inch from its mate.\n\nI waited for another interval.\n\nNothing.\n\nA contact opened; the circuit ceased to answer itself. The mast stood against the clearing sky. Something in me went on running toward it after my body understood.\n\nI closed the housing without reconnecting the line.\n\nThe outgoing path remained.\n\nAt the signal stand, four chimes hung beneath a cover, their rods corresponding to the shelter posts' different heights. My sister had left the reading direction in the scarf's note. I went through the sequence slowly. With the return isolated, no inward strike confused the next. The distant crossing latch released with a dull mechanical report carried down the wire's supports.\n\nNo light told me anyone had heard.\n\nI went across.\n\nMy prints broke the sleet on the crossing boards. From the far support I looked back at the lamp. Its dark glass reflected sky; beneath it stood only a bracket, a bolt, a cable. There was no room for someone to wait.\n\nThe ridge path narrowed between two snow-filled hollows. In the failing afternoon, their surfaces looked smooth enough to lie on. I kept to the stones. At the highest point, I turned once more toward the country behind me.\n\nCloud drifted across it in long bands. A patch of water shone and disappeared. Far down, something caught the light with a brightness too small to name.\n\nI could no longer use brightness as evidence of a person.\n\nI looked at it anyway.\n\nOn the far side of the pass, roofs appeared below a single mast.\n\nThe descending path crossed stone ribs and grass-filled troughs threaded with meltwater. Snow lingered in shade. Lower down, shrubs returned, then small trees.\n\nThe settlement occupied a shelf above a steep drop. Roofs followed its contour in uneven rows, divided by retaining walls and dark slots of alley. Above the houses the mast stood in a web of guy wires. Beyond them the valley filled with dusk, ridge behind paler ridge.\n\nLights burned among the houses. Some were steady; others seemed to waver as the wind moved the last mist between us.\n\nI descended with my sister's scarf under my collar and my own lamp unlit in my bag.\n\nEarlier tin-and-wire record:\n\nHer hand on the dark side: \"The last post is the same height as the first. The inward wire returns each strike into the sequence before the next strike arrives. Its isolator leaves the outgoing wire intact. Do not answer your own reflection.\"\n\nKeeper's hand on the polished side: \"The ridge returns a test pulse. Three flashes alone cannot establish who is at the far end. She knew the distinction. She taught me to check the direction mark.\"\n\nThe marks in the circuit drawing distinguish a returned pulse from an outgoing call. I can now test something both accounts have used as proof. If the light answers automatically, it does not mean she is dead or absent. It means the answer cannot tell me that she is present. I have carried certainty uphill that neither the lamp nor the paper actually gave me.",
    "Her hand on the lamp rail: \"Use the FIRST lamp, the one on the LEFT. Leave the other watches undisturbed. I have left you a way to answer.\"\n\nKeeper's hand: \"Check the arrows before you call the windows witnesses. The returns are marked inward. Nobody looking out is needed to make them shine.\"\n\nThe direction marks match the diagram at the dam. Some lights that seemed to accompany me are outputs of the same circuit I have been repairing. That much is now observable. It does not tell me whether she made a guide that would survive her absence or whether someone used her guide to bring me here. The dark windows beyond those lamps remain windows. There may still be people behind them.",
    "Her hand: \"Three short flashes from the first lamp. Release between each. At the glass, you will know me by the correction. You have seen me make it a hundred times.\"\n\nKeeper's hand: \"Corrections are copied too. Break the circuit to expose the original. Complete it to expose the live pen. The interlock closes the other face. Decide what you need to witness.\"\n\nThe service stamp gives a fixed order: master plate sealed on day one; holding locks fitted on day four. The keeper admits fitting those locks. She refers to them as something done to her. The original might show whether her instructions predated them. The pen might show whether her instructions require her at all. The machine offers a test, not an assurance that I will like its answer.",
    "A rubbing of the cabinet face carries two messages. Her hand: \"Finish what I could not. There is a place for you here. You know which errors I make when I need you to notice.\"\n\nKeeper's hand: \"Do not confuse her words with her will. I locked the doors. I thought I was stopping the system. She said there was no other way. I do not know whose sentence that was.\"\n\nThe glass covers a sheet and a motionless pen. A broken feed releases the original instructions and shutters the pen. A completed feed powers the pen and seals the original away. The choice is physical, not a vote about which person I like. I can leave and reread my journal before acting. When I return, I must decide whether freeing her means interrupting her work or allowing it to finish.",
};

static const char *const ht_story_prose[HT_LEVELS][3] = {
    { "Three flashes crossed the fog last night. My sister taught me that signal.\n\nI have brought a book to record what I find. I want to distinguish what I see from what I hope it means.", "Her cloth marks a path through the trees. Another hand has marked it too.\n\nThe second hand calls its writer the keeper. His marks follow the same route, but his warnings face the people walking toward her.", "Some cuts in the bark are older than her trail. Did she find this way or was she sent?\n\nThe path existed before she used it. That gives her account a history without telling me whose history she entered." },
    { "Her arrows cross the roofs above the fog. The keeper has crossed some of them out.\n\nI can follow either hand far enough to find a useful instruction. Being right about a ladder does not make someone right about a person.", "A ladder is lowered beside a locked door. Escape route or the only route allowed?\n\nThe arrangement is deliberate. It offers a way onward while removing another choice. I cannot see which purpose came first.", "The lamp flashes with nobody beside it. A signal can continue after its maker leaves.\n\nUntil now I have imagined a hand behind every light. The timer carries a message without carrying proof of who is present." },
    { "The pumps are still. the service lamps burn. Someone decided what to keep alive.\n\nFuel makes every instruction costly. A request to move onward can be an order when warmth depends on obeying it.", "Seven allowances are marked on a fuel can. One has been divided among the others.\n\nThe arithmetic is visible. Whether the missing share was offered or taken is not. Both accounts know the same numbers.", "A radio clicks without forming a word. The same rhythm comes from under the floor.\n\nI recognise enough to listen again. Familiarity makes a sound feel personal before I know who, or what, produced it." },
    { "The tracks lead toward three dark cuttings. Only one signal can still open a way.\n\nThe other routes may be ruined, prohibited, or both. A safe instruction can come from someone who helped make the alternatives unsafe.", "A HOME ticket is pinned inside the station. The cancellation came before the collapse.\n\nA prediction and a plan can share a date. I need to know what information existed then, not merely what happened later.", "The bridge route has been corrected by hand. Both writers credit the other for finding it.\n\nGratitude would explain that. So would a wish to move responsibility elsewhere. I keep the two statements together." },
    { "A gate and a ferry token bear the same mark. Payment and permission look alike here.\n\nThe token proves access. It does not tell me whether its holder was travelling freely or being transferred.", "The rope is tied on this side of the water. The log records two days without a crossing.\n\nSomeone could have untied it. That is not proof that they were allowed to. Nor is waiting proof that they wished to leave.", "The same names appear on both banks. One list says released. the other received.\n\nThe crossing happened. The words describe its meaning differently, and the headings that might settle it have washed away." },
    { "The hoist has been repaired with her cloth. The repair makes the handle safe to hold.\n\nThat small kindness survives either account. It cannot tell me whether she chose the work or was forced to make it possible.", "Small footprints pass between the machines. The path has been carefully kept to one side.\n\nSomeone understood the danger. Care can guide people safely through a place; it can also make them trust a guide they cannot question.", "Her note counts six. his correction says seven. He has counted her among them.\n\nPerhaps he wanted her to value her own life. Perhaps he was reminding her that her name remained on the same admission list." },
    { "New rows grow under a broken glass roof. The exit has a lock on the inside.\n\nShelter and confinement need many of the same things: warmth, supplies, walls. Only the freedom to leave distinguishes them.", "A garden count repeats an earlier correction. Even the crossed-out stroke is the same.\n\nCopying a form is ordinary. Copying the sign of a living hesitation feels different. I have been trusting the latter more than the words.", "A child drew her lantern beside an old card. The figures stand in the same order.\n\nA picture can record what happened or teach people what to expect. I do not know which image the child saw first." },
    { "A generator hums behind the spillway wall. Two wires leave the same switch.\n\nOne runs toward the lights. The other disappears into the tower circuit. Restoring one may have meant accepting the other.", "The return pipe carries water back to the beds. The person at this valve controls their heat.\n\nProtecting that supply can be kindness or power over the people who need it. An instruction is harder to refuse when cold follows refusal.", "The diagram links the lamp to a writing arm. A master plate can move a pen without its author.\n\nThe machine offers a physical explanation for the repeated strokes. That establishes an ability, not which pages were made with it." },
    { "Her stitch mark appears on a tower plan. The plan is dated before the first lock.\n\nThe keeper may be shifting blame; the date may be copied incorrectly. The original would tell me more than this tracing.", "She wrote there was no other way. The keeper says she corrected his sealed order.\n\nCoercion, warning and foresight remain possible. Her certainty is evidence that she knew something, not proof of how she knew it.", "Three flashes answer from the ridge. The diagram also shows an automatic return.\n\nA reply can feel like recognition even when no person receives it. I must check the direction before calling the light a witness." },
    { "Windows shine beyond the signal mast. The return marks point back into the circuit.\n\nSome of the lights can work without watchers. There may still be people behind the windows. I cannot substitute one uncertainty for another.", "The last cabinet has two interlocked faces. Opening either will close the other.\n\nI can interrupt the feed to expose the original, or complete it to witness the pen. The mechanism cannot show me both in one crossing.", "Her words and the keepers warning lie together. I must decide what i am willing to complete.\n\nThe original predates the locks; the live pen can reproduce a correction. These are testable facts. Whether I am rescuing her or doing her work is the conclusion I bring to the glass." },
};
