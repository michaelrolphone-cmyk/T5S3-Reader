/* A single history: both mechanisms exist. The player's action selects the
 * observable face, not a retroactive author, date, or motivation. */
static const char *const ht_final_testimony[2] = {
    "THE ORIGINAL UNDER THE GLASS\n\n"
    "I broke the circuit to stop what had been done to her. The lamps died. A spring released the sheet beneath her testimony; the shutter over the pen snapped closed.\n\n"
    "This is not a copy. There are ruled construction lines beneath the ink and the pressure of her backward stitch in the margin. The keeper's day-one seal passes through paper and plate. The locks were not fitted until day four.\n\n"
    "In her hand: 'Fit the holding locks only after the master is sealed. Leave the western route legible. If my sibling reaches the final cabinet, they will break the feed to release me. Their interruption must release this original. Do not let anyone perform it in their place.'\n\n"
    "She described my rescue before the captivity described in her letters. I have not disproved coercion: someone could have made her write this too. But I can no longer believe she was merely carried along a route she did not understand. My attempt to free her has completed an instruction bearing her name.\n\n"
    "Under the last line she has corrected three short flashes to two short and one long. Someone is watching. It is the deliberate error she taught me as a child.\n\n"
    "Is she warning me from inside her own plan? Or did whoever taught the machine her handwriting learn this as well?\n\n"
    "The sealed live pen cannot answer. The way beyond the tower is open. I put the changed testimony in my journal and leave with the question I thought my choice would settle.",
    "THE PEN BEHIND THE GLASS\n\n"
    "I completed the circuit because I believed she knew what she was doing. The lamp steadied. A shutter sealed the original plate; the glass lifted over the writing arm.\n\n"
    "There is no hand on the pen. It writes the message I carried from the forest, then the promise from the gardens. It hesitates at the same letter. It makes her correction. The blot that made me certain she was there appears again beneath the moving nib.\n\n"
    "The selector advances to a strip marked ARRIVAL. The pen addresses me in the words she used when I was small: 'There is a place for you here. Finish what I could not.'\n\n"
    "I trusted those errors more than a signature. I have just watched a mechanism make them. The papers did not establish her presence or her consent. They could have been instructions she deliberately entrusted to it, or her voice used after she was no longer free to speak. Completing her work has powered the thing that can impersonate her.\n\n"
    "The pen crosses out three short flashes and writes two short and one long. Someone is watching. It is the deliberate error she taught me as a child.\n\n"
    "Did she hide a warning in the master? Or has the machine learned how to make a warning feel like her?\n\n"
    "The original is sealed on the other face. The way beyond the tower is open. I put the changed testimony in my journal. I can hear the pen beginning the next copy as I leave."
};
