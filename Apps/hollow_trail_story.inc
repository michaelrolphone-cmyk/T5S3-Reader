/* Progress narration observes; it never settles either witness's motive. */
typedef struct { const char *title; const char *lines[3][2]; } ht_chapter;
static const ht_chapter ht_chapters[HT_LEVELS] = {
    { "1: DARK FOREST", {
        { "THREE FLASHES CROSSED THE FOG LAST NIGHT.", "MY SISTER TAUGHT ME THAT SIGNAL." },
        { "HER CLOTH MARKS A PATH THROUGH THE TREES.", "ANOTHER HAND HAS MARKED IT TOO." },
        { "SOME CUTS IN THE BARK ARE OLDER THAN HER TRAIL.", "DID SHE FIND THIS WAY OR WAS SHE SENT?" },
    } },
    { "2: SKYSCRAPERS", {
        { "HER ARROWS CROSS THE ROOFS ABOVE THE FOG.", "THE KEEPER HAS CROSSED SOME OF THEM OUT." },
        { "A LADDER IS LOWERED BESIDE A LOCKED DOOR.", "ESCAPE ROUTE OR THE ONLY ROUTE ALLOWED?" },
        { "THE LAMP FLASHES WITH NOBODY BESIDE IT.", "A SIGNAL CAN CONTINUE AFTER ITS MAKER LEAVES." },
    } },
    { "3: OIL FIELDS", {
        { "THE PUMPS ARE STILL. THE SERVICE LAMPS BURN.", "SOMEONE DECIDED WHAT TO KEEP ALIVE." },
        { "SEVEN ALLOWANCES ARE MARKED ON A FUEL CAN.", "ONE HAS BEEN DIVIDED AMONG THE OTHERS." },
        { "A RADIO CLICKS WITHOUT FORMING A WORD.", "THE SAME RHYTHM COMES FROM UNDER THE FLOOR." },
    } },
    { "4: SILENT RAILYARD", {
        { "THE TRACKS LEAD TOWARD THREE DARK CUTTINGS.", "ONLY ONE SIGNAL CAN STILL OPEN A WAY." },
        { "A HOME TICKET IS PINNED INSIDE THE STATION.", "THE CANCELLATION CAME BEFORE THE COLLAPSE." },
        { "THE BRIDGE ROUTE HAS BEEN CORRECTED BY HAND.", "BOTH WRITERS CREDIT THE OTHER FOR FINDING IT." },
    } },
    { "5: DROWNED MARSH", {
        { "A GATE AND A FERRY TOKEN BEAR THE SAME MARK.", "PAYMENT AND PERMISSION LOOK ALIKE HERE." },
        { "THE ROPE IS TIED ON THIS SIDE OF THE WATER.", "THE LOG RECORDS TWO DAYS WITHOUT A CROSSING." },
        { "THE SAME NAMES APPEAR ON BOTH BANKS.", "ONE LIST SAYS RELEASED. THE OTHER RECEIVED." },
    } },
    { "6: WHITE QUARRY", {
        { "THE HOIST HAS BEEN REPAIRED WITH HER CLOTH.", "THE REPAIR MAKES THE HANDLE SAFE TO HOLD." },
        { "SMALL FOOTPRINTS PASS BETWEEN THE MACHINES.", "THE PATH HAS BEEN CAREFULLY KEPT TO ONE SIDE." },
        { "HER NOTE COUNTS SIX. HIS CORRECTION SAYS SEVEN.", "HE HAS COUNTED HER AMONG THEM." },
    } },
    { "7: GLASS GARDENS", {
        { "NEW ROWS GROW UNDER A BROKEN GLASS ROOF.", "THE EXIT HAS A LOCK ON THE INSIDE." },
        { "A GARDEN COUNT REPEATS AN EARLIER CORRECTION.", "EVEN THE CROSSED-OUT STROKE IS THE SAME." },
        { "A CHILD DREW HER LANTERN BESIDE AN OLD CARD.", "THE FIGURES STAND IN THE SAME ORDER." },
    } },
    { "8: THE BROKEN DAM", {
        { "A GENERATOR HUMS BEHIND THE SPILLWAY WALL.", "TWO WIRES LEAVE THE SAME SWITCH." },
        { "THE RETURN PIPE CARRIES WATER BACK TO THE BEDS.", "THE PERSON AT THIS VALVE CONTROLS THEIR HEAT." },
        { "THE DIAGRAM LINKS THE LAMP TO A WRITING ARM.", "A MASTER PLATE CAN MOVE A PEN WITHOUT ITS AUTHOR." },
    } },
    { "9: THE HIGH PASS", {
        { "HER STITCH MARK APPEARS ON A TOWER PLAN.", "THE PLAN IS DATED BEFORE THE FIRST LOCK." },
        { "SHE WROTE THERE WAS NO OTHER WAY.", "THE KEEPER SAYS SHE CORRECTED HIS SEALED ORDER." },
        { "THREE FLASHES ANSWER FROM THE RIDGE.", "THE DIAGRAM ALSO SHOWS AN AUTOMATIC RETURN." },
    } },
    { "10: THE LAST LIGHT", {
        { "WINDOWS SHINE BEYOND THE SIGNAL MAST.", "THE RETURN MARKS POINT BACK INTO THE CIRCUIT." },
        { "THE LAST CABINET HAS TWO INTERLOCKED FACES.", "OPENING EITHER WILL CLOSE THE OTHER." },
        { "HER WORDS AND THE KEEPERS WARNING LIE TOGETHER.", "I MUST DECIDE WHAT I AM WILLING TO COMPLETE." },
    } },
};
static unsigned ht_story_beat(int progress) { return progress>=2600?2u:progress>=1100?1u:0u; }
