/* Harness for the verbatim production stop/wait functions, generated by the
 * runner. MMIO progress is simulated; register layout is the pinned SDK's. */
#include <assert.h>
#include <stdbool.h>
#include <stdint.h>
#include <stdio.h>
#include <string.h>
#include <soc/usb_wrap_struct.h>
static usb_wrap_dev_t wrap;
static uint32_t rx, bad_control, bad_wrap;
static usb_wrap_dev_t *usb(void) {
 wrap.test_conf.val=((wrap.test_conf.val&~0x70u)|rx)&~bad_control;
 wrap.otg_conf.val&=~bad_wrap;
 return &wrap;
}
#define USB_WRAP (*usb())
static struct {struct {bool sw_hw_usb_phy_sel,sw_usb_phy_sel;} usb_conf;} RTCCNTL;
#include "Drivers/usb_controller_esp32s3/PhyRoute.h"
static struct {struct {bool usb_clk_en;} perip_clk_en0;} SYSTEM;
static struct {struct {uint32_t val;} func_in_sel_cfg[4];} GPIO;
static const uint16_t input_signal[4]={0,1,2,3};
static bool live,healthy,saved_clock,fail_clock,fail_drive,fail_reset,fail_idle;
static uint32_t saved_wrap,saved_test,saved_inputs[4];
static uint8_t saved_drive[2],drive[2];
static unsigned timeouts,resets;
#define IO_MUX_GPIO19_REG 0
#define IO_MUX_GPIO20_REG 1
#define FUN_DRV 0
#define REG_GET_FIELD(reg,field) drive[reg]
#define ESP_OK 0
typedef unsigned gpio_drive_cap_t;
static int gpio_set_drive_capability(unsigned pin,gpio_drive_cap_t cap){if(fail_drive)return -1;drive[pin-19]=cap;return 0;}
static void usb_phy_ll_usb_wrap_enable_bus_clock(bool on){if(!fail_clock)SYSTEM.perip_clk_en0.usb_clk_en=on;}
static void risc_msc_stack_reset(void){++resets;}
static void risc_msc_timeout(unsigned reason){assert(reason==1);++timeouts;}
#define DCTL_SDIS 2u
#define GAHBCFG_GINT 1u
#define GAHBCFG_DMAEN 32u
#define GRSTCTL_CSRST 1u
#define GRSTCTL_AHBIDL 0x80000000u
typedef struct {uint32_t dctl,gintmsk,gahbcfg;volatile uint32_t grstctl;} dwc2_regs_t;
static dwc2_regs_t hw;
static dwc2_regs_t *regs(void){return &hw;}
/* PRODUCTION_WAIT */
static bool wait_bits(volatile uint32_t *reg,uint32_t mask,bool set){
 if(mask==GRSTCTL_CSRST && !fail_reset)*reg&=~mask;
 if(mask==GRSTCTL_AHBIDL && !fail_idle)*reg|=mask;
 return production_wait_bits(reg,mask,set);
}
/* PRODUCTION_STOP */
static void reset_case(uint32_t saved,uint32_t received){
 memset(&hw,0,sizeof(hw));hw.gahbcfg=GAHBCFG_GINT|GAHBCFG_DMAEN;hw.gintmsk=~0u;
 memset(&wrap,0,sizeof(wrap));rx=received;bad_control=bad_wrap=0;
 fail_clock=fail_drive=fail_reset=fail_idle=false;
 live=healthy=phyRouteCaptured=true;saved_clock=false;SYSTEM.perip_clk_en0.usb_clk_en=true;
 saved_wrap=0x80000001u;saved_test=saved;
 savedPhyOverride=true;savedPhySelect=false;RTCCNTL.usb_conf.sw_hw_usb_phy_sel=false;RTCCNTL.usb_conf.sw_usb_phy_sel=true;
 for(unsigned i=0;i<4;++i){saved_inputs[i]=i+10;GPIO.func_in_sel_cfg[i].val=0;}
 saved_drive[0]=1;saved_drive[1]=2;drive[0]=drive[1]=3;timeouts=resets=0;
}
static void restored(void){
 assert(!live && healthy && !phyRouteCaptured && !SYSTEM.perip_clk_en0.usb_clk_en);
 assert(RTCCNTL.usb_conf.sw_hw_usb_phy_sel && !RTCCNTL.usb_conf.sw_usb_phy_sel);
 assert(!(hw.gahbcfg&(GAHBCFG_GINT|GAHBCFG_DMAEN)) && !hw.gintmsk && (hw.dctl&DCTL_SDIS));
 assert(drive[0]==1 && drive[1]==2);
 for(unsigned i=0;i<4;++i)assert(GPIO.func_in_sel_cfg[i].val==saved_inputs[i]);
 assert(resets && risc_msc_transport_stop());
}
int main(void){
 reset_case(0x05,0x70);assert(risc_msc_transport_stop());assert(!timeouts);restored();
 puts("PASS saved 0x05 / observed 0x75: no false retained shutdown");
 for(unsigned saved=0;saved<128;++saved)for(unsigned received=0;received<128;received+=16){
  reset_case(saved,received);assert(risc_msc_transport_stop());restored();
 }
 puts("PASS 1024 control/receive combinations and idempotent stop");
 for(unsigned bit=1;bit<=8;bit<<=1){reset_case(15,0x70);bad_control=bit;assert(!risc_msc_transport_stop() && live && phyRouteCaptured);bad_control=0;assert(risc_msc_transport_stop());restored();}
 puts("PASS all writable control mismatches retained; retry restores CDC route");
 reset_case(5,0x70);bad_wrap=1;assert(!risc_msc_transport_stop()&&live&&phyRouteCaptured);bad_wrap=0;assert(risc_msc_transport_stop());restored();
 for(unsigned kind=0;kind<4;++kind){
  reset_case(5,0x70);fail_reset=kind==0;fail_idle=kind==1;fail_drive=kind==2;fail_clock=kind==3;
  assert(!risc_msc_transport_stop()&&live&&phyRouteCaptured);
  if(kind<2)assert(timeouts==1 && !resets);
  fail_reset=fail_idle=fail_drive=fail_clock=false;assert(risc_msc_transport_stop());restored();
 }
 puts("PASS reset, idle, pad, wrap and clock failures retain ownership until successful retry");
}
